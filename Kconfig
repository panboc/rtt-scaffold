## Kconfig
```kconfig
mainmenu "RT-Thread Configuration"

config BSP_DIR
    string
    option env="BSP_ROOT"
    default "."

config SOC_DIR
    string
    option env="SOC_ROOT"
    default "common/devices"

config LIBS_DIR
    string
    option env="LIBS_ROOT"
    default "common/libraries"

config PKGS_DIR
    string
    option env="PKGS_ROOT"
    default "common/packages"

config RTT_DIR
    string
    option env="RTT_ROOT"
    default "common/rtt-kernel/4.0.2"
    
source "$SOC_DIR/Kconfig"
source "$RTT_DIR/src/Kconfig"
source "$RTT_DIR/libcpu/Kconfig"
source "$RTT_DIR/components/Kconfig"
source "$LIBS_DIR/ST/Kconfig"
source "board/Kconfig"
```

## common/devices/GigaDevice/GD32F4xx_Series/GD32F407/Kconfig
```kconfig
choice
    prompt "Chip"
    default n
    
    config SOC_GD32F407IE
        bool "GD32F407IE"
    config SOC_GD32F407IG
        bool "GD32F407IG"
    config SOC_GD32F407IK
        bool "GD32F407IK"
    config SOC_GD32F407RE
        bool "GD32F407RE"
    config SOC_GD32F407RG
        bool "GD32F407RG"
    config SOC_GD32F407RK
        bool "GD32F407RK"
    config SOC_GD32F407VE
        bool "GD32F407VE"
    config SOC_GD32F407VG
        bool "GD32F407VG"
    config SOC_GD32F407VK
        bool "GD32F407VK"
    config SOC_GD32F407ZE
        bool "GD32F407ZE"
    config SOC_GD32F407ZG
        bool "GD32F407ZG"
    config SOC_GD32F407ZK
        bool "GD32F407ZK"
endchoice
```

## common/devices/GigaDevice/GD32F4xx_Series/Kconfig
```kconfig
choice
    prompt "Sub Series"
    default n
    
    config SOC_GD32F403
        bool "GD32F403"
    config SOC_GD32F405
        bool "GD32F405"
    config SOC_GD32F407
        bool "GD32F407"
    config SOC_GD32F450
        bool "GD32F450"
endchoice

if SOC_GD32F403
endif

if SOC_GD32F405
endif

if SOC_GD32F407
    source "common/devices/GigaDevice/GD32F4xx_Series/GD32F407/Kconfig"
endif

if SOC_GD32F450
endif
```

## common/devices/GigaDevice/Kconfig
```kconfig
choice
    prompt "Series"
    default n
    
    config SOC_GD32E10X
        bool "GD32E10x Series"
    config SOC_GD32E23X
        bool "GD32E23x Series"
    config SOC_GD32E50X
        bool "GD32E50x Series"
    config SOC_GD32F10X
        bool "GD32F10x Series"
    config SOC_GD32F1X0
        bool "GD32F1x0 Series"
    config SOC_GD32F20X
        bool "GD32F20x Series"
    config SOC_GD32F30X
        bool "GD32F30x Series"
    config SOC_GD32F3X0
        bool "GD32F3x0 Series"
    config SOC_GD32F4XX
        bool "GD32F4xx Series"
    config SOC_GD32L23X
        bool "GD32L23x Series"
    config SOC_GD32W51X
        bool "GD32W51x Series"
endchoice

if SOC_GD32E10X
endif

if SOC_GD32E23X
endif

if SOC_GD32E50X
endif

if SOC_GD32F10X
endif

if SOC_GD32F1X0
endif

if SOC_GD32F20X
endif

if SOC_GD32F30X
endif

if SOC_GD32F3X0
endif

if SOC_GD32F4XX
    source "common/devices/GigaDevice/GD32F4xx_Series/Kconfig"
endif

if SOC_GD32L23X
endif

if SOC_GD32W51X
endif
```

## common/devices/Kconfig
```kconfig
menu "SOC Devices"

choice
    prompt "Manufacturer"
    default n

    config MFR_ABOVSemiconductor
        bool "ABOVSemiconductor"
    config MFR_ActiveSemi
        bool "ActiveSemi"
    config MFR_AmbiqMicro
        bool "AmbiqMicro"
    config MFR_Amiccom
        bool "Amiccom"
    config MFR_AnalogDevices
        bool "AnalogDevices"
    config MFR_APEXMIC
        bool "APEXMIC"
    config MFR_ARM
        bool "ARM"
    config MFR_AutoChips
        bool "AutoChips"
    config MFR_BrainChip
        bool "BrainChip"
    config MFR_Cmsemicon
        bool "Cmsemicon"
    config MFR_Cypress
        bool "Cypress"
    config MFR_DialogSemiconductor
        bool "DialogSemiconductor"
    config MFR_ELAN
        bool "ELAN"
    config MFR_FMD
        bool "FMD"
    config MFR_FMSH
        bool "FMSH"
    config MFR_Geehy
        bool "Geehy"
    config MFR_GigaDevice
        bool "GigaDevice"
    config MFR_Goodix
        bool "Goodix"
    config MFR_HDSC
        bool "HDSC"
    config MFR_Holtex
        bool "Holtex"
    config MFR_Infineon
        bool "Infineon"
    config MFR_LapisSemiconductor
        bool "LapisSemiconductor"
    config MFR_Maxim
        bool "Maxim"
    config MFR_MediaTek
        bool "MediaTek"
    config MFR_Megawin
        bool "Megawin"
    config MFR_Microchip
        bool "Microchip"
    config MFR_Microsemi
        bool "Microsemi"
    config MFR_MindMotion
        bool "MindMotion"
    config MFR_NordicSemiconductor
        bool "NordicSemiconductor"
    config MFR_Nuvoton
        bool "Nuvoton"
    config MFR_NXP
        bool "NXP"
    config MFR_RelChip
        bool "RelChip"
    config MFR_Renesas
        bool "Renesas"
    config MFR_SILAN
        bool "SILAN"
    config MFR_SiliconLabs
        bool "SiliconLabs"
    config MFR_Sinowealth
        bool "Sinowealth"
    config MFR_SONiX
        bool "SONiX"
    config MFR_STMicroelectronics
        bool "STMicroelectronics"
    config MFR_TexasInstruments
        bool "TexasInstruments"
    config MFR_Toshiba
        bool "Toshiba"
    config MFR_XMC
        bool "XMC"
    config MFR_Zilog
        bool "Zilog"
endchoice

if MFR_ABOVSemiconductor
endif

if MFR_ActiveSemi
endif

if MFR_AmbiqMicro
endif

if MFR_Amiccom
endif

if MFR_AnalogDevices
endif

if MFR_APEXMIC
endif

if MFR_ARM
endif

if MFR_AutoChips
endif

if MFR_BrainChip
endif

if MFR_Cmsemicon
endif

if MFR_Cypress
endif

if MFR_DialogSemiconductor
endif

if MFR_ELAN
endif

if MFR_FMD
endif

if MFR_FMSH
endif

if MFR_Geehy
endif

if MFR_GigaDevice
    source "common/devices/GigaDevice/Kconfig"
endif

if MFR_Goodix
endif

if MFR_HDSC
endif

if MFR_Holtex
endif

if MFR_Infineon
endif

if MFR_LapisSemiconductor
endif

if MFR_Maxim
endif

if MFR_MediaTek
endif

if MFR_Megawin
endif

if MFR_Microchip
endif

if MFR_Microsemi
endif

if MFR_MindMotion
endif

if MFR_NordicSemiconductor
endif

if MFR_Nuvoton
endif

if MFR_NXP
endif

if MFR_RelChip
endif

if MFR_Renesas
endif

if MFR_SILAN
endif

if MFR_SiliconLabs
endif

if MFR_Sinowealth
endif

if MFR_SONiX
endif

if MFR_STMicroelectronics
    source "common/devices/STMicroelectronics/Kconfig"
endif

if MFR_TexasInstruments
endif

if MFR_Toshiba
endif

if MFR_XMC
endif

if MFR_Zilog
endif

endmenu
```

## common/devices/STMicroelectronics/Kconfig
```kconfig
choice
    prompt "Series"
    default n
    
    config SOC_STBlueNRG1
        bool "STBlueNRG1 Series"
    config SOC_STBlueNRG2
        bool "STBlueNRG2 Series"
    config SOC_STBlueNRGLP
        bool "STBlueNRGLP Series"
    config SOC_STBlueNRG
        bool "STBlueNRG Series"
    config SOC_STM32F0
        bool "STM32F0 Series"
    config SOC_STM32F1
        bool "STM32F1 Series"
    config SOC_STM32F2
        bool "STM32F2 Series"
    config SOC_STM32F3
        bool "STM32F3 Series"
    config SOC_STM32F4
        bool "STM32F4 Series"
    config SOC_STM32F7
        bool "STM32F7 Series"
    config SOC_STM32G0
        bool "STM32G0 Series"
    config SOC_STM32G4
        bool "STM32G4 Series"
    config SOC_STM32H7
        bool "STM32H7 Series"
    config SOC_STM32L0
        bool "STM32L0 Series"
    config SOC_STM32L1
        bool "STM32L1 Series"
    config SOC_STM32L4
        bool "STM32L4 Series"
    config SOC_STM32L5
        bool "STM32L5 Series"
    config SOC_STM32MP1
        bool "STM32MP1 Series"
    config SOC_STM32U5
        bool "STM32U5 Series"
    config SOC_STM32W1
        bool "STM32W1 Series"
    config SOC_STM32WB
        bool "STM32WB Series"
    config SOC_STM32WL
        bool "STM32WL Series"
endchoice
    
if SOC_STBlueNRG1
endif

if SOC_STBlueNRG2
endif

if SOC_STBlueNRGLP
endif

if SOC_STBlueNRG
endif

if SOC_STM32F0
endif

if SOC_STM32F1
endif

if SOC_STM32F2
endif

if SOC_STM32F3
endif

if SOC_STM32F4
endif

if SOC_STM32F7
endif

if SOC_STM32G0
endif

if SOC_STM32G4
endif

if SOC_STM32H7
    source "common/devices/STMicroelectronics/STM32H7_Series/Kconfig"
endif

if SOC_STM32L0
endif

if SOC_STM32L1
endif

if SOC_STM32L4
endif

if SOC_STM32L5
endif

if SOC_STM32MP1
endif

if SOC_STM32U5
endif

if SOC_STM32W1
endif

if SOC_STM32WB
endif

if SOC_STM32WL
endif
```

## common/devices/STMicroelectronics/STM32H7_Series/Kconfig
```kconfig
choice
    prompt "Sub Series"
    default n
    
  config SOC_STM32H742
      bool "STM32H742"
  config SOC_STM32H743
      bool "STM32H743"
  config SOC_STM32H745
      bool "STM32H745"
  config SOC_STM32H747
      bool "STM32H747"
  config SOC_STM32H750
      bool "STM32H750"
  config SOC_STM32H753
      bool "STM32H753"
  config SOC_STM32H755
      bool "STM32H755"
  config SOC_STM32H757
      bool "STM32H757"
  config SOC_STM32H7A3
      bool "STM32H7A3"
  config SOC_STM32H7B0
      bool "STM32H7B0"
  config SOC_STM32H7B3
      bool "STM32H7B3"
endchoice

if SOC_STM32H742
endif

if SOC_STM32H743
endif

if SOC_STM32H745
    source "common/devices/STMicroelectronics/STM32H7_Series/STM32H745/Kconfig"
endif

if SOC_STM32H747
endif

if SOC_STM32H750
endif

if SOC_STM32H753
endif

if SOC_STM32H755
endif

if SOC_STM32H757
endif

if SOC_STM32H7A3
endif

if SOC_STM32H7B0
endif

if SOC_STM32H7B3
endif
```

## common/devices/STMicroelectronics/STM32H7_Series/STM32H745/Kconfig
```kconfig
choice
    prompt "Chip"
    default SOC_STM32H745BGT
    
    config SOC_STM32H745BGT
        bool "STM32H745BGTx"

    config SOC_STM32H745BIT
        bool "STM32H745BITx"

    config SOC_STM32H745IGK
        bool "STM32H745IGKx"

    config SOC_STM32H745IGT
        bool "STM32H745IGTx"

    config SOC_STM32H745IIK
        bool "STM32H745IIKx"

    config SOC_STM32H745IIT
        bool "STM32H745IITx"

    config SOC_STM32H745XGH
        bool "STM32H745XGHx"

    config SOC_STM32H745XIH
        bool "STM32H745XIHx"

    config SOC_STM32H745ZGT
        bool "STM32H745ZGTx"

    config SOC_STM32H745ZIT
        bool "STM32H745ZITx"    
endchoice
```
